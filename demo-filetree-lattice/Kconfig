## demo-filetree-lattice/Kconfig
```kconfig
mainmenu "Freertrtos Autopilot Configuration"

config BOARD_THEJAS32
	bool "THEJAS32 reference board"
	default y
	help
	  Build the board support package for the THEJAS32 RISC-V target.

config BOARD_SITL
	bool "Software-in-the-loop board"
	default n
	help
	  Build the host-side board shim used by SITL tests.

config MODULE_MAVLINK
	bool "MAVLink telemetry and GCS protocol"
	default y
	help
	  Enable the MAVLink module. Required for Mission Planner / QGC
	  telemetry, command handling and mission upload.

config MODULE_LOGGER
	bool "Flight logger"
	default y
	help
	  Enable binary flight and mission logging.

config MODULE_RC_INPUT
	bool "RC input"
	default y
	help
	  Enable SBUS/CRSF RC input and manual control.

config FREERTRTOS_USE_FPU
	bool "Use hardware floating point"
	default n
	help
	  Enable the RISC-V FPU context in the freertrtos port. Keep disabled
	  for the first bring-up unless the core and toolchain are known good.

source "os/freertrtos/Kconfig"
```

## demo-filetree-lattice/os/freertrtos/Kconfig
```kconfig
menu "freertrtos"

config FREERTRTOS_TICK_HZ
	int "Kernel tick rate (Hz)"
	default 1000
	help
	  Keep this at 1000 for the flight stack. Lower values reduce overhead
	  but make the 1 kHz rate loop impossible without a hardware timer.

config FREERTRTOS_HEAP_BYTES
	int "FreeRTOS heap size (bytes)"
	default 65536
	help
	  Heap for kernel objects and third-party libraries. Flight code should
	  use static allocation; the heap is not a general-purpose allocator.

config FREERTRTOS_USE_FPU
	bool "Save/restore FPU context"
	default n
	help
	  Must match the RISC-V port and the compiler ABI. Leave disabled for
	  the first bring-up.

config FREERTRTOS_WATCHDOG
	bool "Enable the task watchdog"
	default y
	help
	  Reset or failsafe when a flight task misses its deadline.

endmenu
```
